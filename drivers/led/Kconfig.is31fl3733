## drivers/led/Kconfig.is31fl3733
```kconfig
# Copyright (c) 2022 Javier Alvarez <javier.alvarez@allthingsembedded.net>
# SPDX-License-Identifier: Apache-2.0

config IS31FL3733
	bool "IS31FL3733 12x16 dots matrix led driver"
	depends on I2C
	help
	  Enable driver for IS31FL3733.
```

## dts/bindings/led/lumissil,is31fl3733.yaml
```yaml
# Copyright (c) 2022, Javier Alvarez <javier.alvarez@allthingsembedded.net>
# SPDX-License-Identifier: Apache-2.0

description: IS31FL3733 Dots matrix led driver

compatible: "lumissil,is31fl3733"

include: [i2c-device.yaml]

properties:
    power-gpios:
      required: false
      type: phandle-array
      description: |
        Handle to a pin used for powering on/off the led supply.

    auto-breath-mode-1:
      required: false
      type: array
      description: |
        Timings for auto-breath-mode 1. Must be an array <T1 T2 T3 T4>.

    auto-breath-mode-2:
      required: false
      type: array
      description: |
        Timings for auto-breath-mode 2. Must be an array <T1 T2 T3 T4>.

    auto-breath-mode-3:
      required: false
      type: array
      description: |
        Timings for auto-breath-mode 3. Must be an array <T1 T2 T3 T4>.

    global-current-control:
      required: false
      type: int
      description: |
        The setting for the GCC register. Defaults to 128. Must be a number
        between 0 and 255.

child-binding:
    description: Led child node
    properties:
        type:
          required: true
          type: string
          enum:
           - "rgb"
           - "breathing-rgb"
          description: |
            The type of LED

        channels:
          required: true
          type: array
          description: |
            An array of 3 channels in order <Red Green Blue>.

        breath-modes:
          required: false
          type: array
          description: |
            An array of 3 elements for each channel of the led. Accepted
            values are 0, 1 or 2, indicating the selected auto-breath-mode index.

        default-color:
          required: false
          type: array
          description: |
            The default LED color, as a 3-integer array in order <Red Green Blue>.
```
